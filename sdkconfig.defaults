## sdkconfig.defaults
```kconfig
# Bluetooth: NimBLE
CONFIG_BT_ENABLED=y
CONFIG_BT_NIMBLE_ENABLED=y
CONFIG_BT_NIMBLE_50_FEATURE_SUPPORT=n

# CPU 频率
CONFIG_ESP_DEFAULT_CPU_FREQ_MHZ_240=y

# FreeRTOS
CONFIG_FREERTOS_HZ=1000

# 任务栈
CONFIG_ESP_MAIN_TASK_STACK_SIZE=8192
CONFIG_FREERTOS_TIMER_TASK_STACK_DEPTH=4096

# NimBLE 内存分配（有 PSRAM 时自动走外部 RAM，释放内部 RAM）
CONFIG_BT_NIMBLE_MEM_ALLOC_MODE_EXTERNAL=y

# ATT MTU（保证 40 字节以上的认证消息一次性写入）
CONFIG_BT_NIMBLE_ATT_PREFERRED_MTU=256
```
