#include "OLED.h"

// ============================================================
// 引脚定义：P2.2 — SCL, P2.3 — SDA（独立引脚，不与板上 I2C 总线冲突）
// ============================================================
sbit OLED_SCL = P2^2;
sbit OLED_SDA = P2^3;

#define OLED_ADDR  0x78      // SSD1306 I2C 地址 (0x3C << 1)

// I2C 位延时（~2-4 µs @ 12MHz，属于 I2C 协议层的一部分）
#define OLED_I2C_DELAY()  { unsigned char _d = 2; while (--_d); }

// ============================================================
// I2C 协议原语（复用 I2C 协议，使用 OLED 独立引脚）
// ============================================================
static void OLED_I2C_Start(void) {
    OLED_SDA = 1;  OLED_I2C_DELAY();
    OLED_SCL = 1;  OLED_I2C_DELAY();
    OLED_SDA = 0;  OLED_I2C_DELAY();
    OLED_SCL = 0;  OLED_I2C_DELAY();
}

static void OLED_I2C_Stop(void) {
    OLED_SDA = 0;  OLED_I2C_DELAY();
    OLED_SCL = 1;  OLED_I2C_DELAY();
    OLED_SDA = 1;  OLED_I2C_DELAY();
}

static void OLED_I2C_SendByte(unsigned char dat) {
    unsigned char i;
    for (i = 0; i < 8; i++) {
        if (dat & 0x80) OLED_SDA = 1; else OLED_SDA = 0;
        OLED_I2C_DELAY();
        OLED_SCL = 1;  OLED_I2C_DELAY();
        OLED_SCL = 0;
        dat <<= 1;
    }
    // 额外时钟（不检查应答）
    OLED_SDA = 1;  OLED_I2C_DELAY();
    OLED_SCL = 1;  OLED_I2C_DELAY();
    OLED_SCL = 0;
}

// ============================================================
// SSD1306 基本操作
// ============================================================
void OLED_WriteCommand(unsigned char cmd) {
    OLED_I2C_Start();
    OLED_I2C_SendByte(OLED_ADDR);
    OLED_I2C_SendByte(0x00);    // Co=0, D/C#=0 → 命令
    OLED_I2C_SendByte(cmd);
    OLED_I2C_Stop();
}

void OLED_WriteData(unsigned char dat) {
    OLED_I2C_Start();
    OLED_I2C_SendByte(OLED_ADDR);
    OLED_I2C_SendByte(0x40);    // Co=0, D/C#=1 → 数据
    OLED_I2C_SendByte(dat);
    OLED_I2C_Stop();
}

static void OLED_SetCursor(unsigned char y, unsigned char x) {
    OLED_WriteCommand(0xB0 | y);                     // 页地址 (0~7)
    OLED_WriteCommand(0x10 | ((x & 0xF0) >> 4));     // 列高4位
    OLED_WriteCommand(0x00 | (x & 0x0F));            // 列低4位
}

// ============================================================
// SSD1306 初始化
// ============================================================
void OLED_Init(void) {
    Delay(200);     // 等待 OLED 供电稳定

    OLED_WriteCommand(0xAE);    // 关闭显示
    OLED_WriteCommand(0xD5);    // 设置显示时钟分频
    OLED_WriteCommand(0x80);
    OLED_WriteCommand(0xA8);    // 设置多路复用率
    OLED_WriteCommand(0x3F);
    OLED_WriteCommand(0xD3);    // 设置显示偏移
    OLED_WriteCommand(0x00);
    OLED_WriteCommand(0x40);    // 设置显示开始行
    OLED_WriteCommand(0xA1);    // 左右方向正常
    OLED_WriteCommand(0xC8);    // 上下方向正常
    OLED_WriteCommand(0xDA);    // COM 引脚配置
    OLED_WriteCommand(0x12);
    OLED_WriteCommand(0x81);    // 对比度
    OLED_WriteCommand(0xCF);
    OLED_WriteCommand(0xD9);    // 预充电周期
    OLED_WriteCommand(0xF1);
    OLED_WriteCommand(0xDB);    // VCOMH
    OLED_WriteCommand(0x30);
    OLED_WriteCommand(0xA4);    // 全局显示开启
    OLED_WriteCommand(0xA6);    // 正常显示 (非反色)
    OLED_WriteCommand(0x8D);    // 充电泵
    OLED_WriteCommand(0x14);
    OLED_Clear();
    OLED_WriteCommand(0xAF);    // 开启显示
}

// ============================================================
// 全屏清空
// ============================================================
void OLED_Clear(void) {
    unsigned char i, j;
    for (j = 0; j < 8; j++) {
        OLED_SetCursor(j, 0);
        for (i = 0; i < 128; i++)
            OLED_WriteData(0x00);
    }
}

// ============================================================
// 6×8 ASCII 字库 (0x20 ~ 0x7E)，存放于 CODE 区，不占 RAM
// ============================================================
static unsigned char code F6x8[95][6] = {
    {0x00,0x00,0x00,0x00,0x00,0x00},
    {0x00,0x00,0x00,0x2F,0x00,0x00},
    {0x00,0x00,0x07,0x00,0x07,0x00},
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    {0x02,0x01,0x02,0x04,0x02,0x00},
};

// ============================================================
// 显示单个字符 (6×8)
// ============================================================
void OLED_ShowChar(unsigned char x, unsigned char y, unsigned char ch) {
    unsigned char i;
    if (ch < 0x20 || ch > 0x7E) ch = 0x20;
    ch -= 0x20;
    OLED_SetCursor(y, x);
    for (i = 0; i < 6; i++)
        OLED_WriteData(F6x8[ch][i]);
}

// ============================================================
// 显示字符串 (6×8 ASCII)
// ============================================================
void OLED_ShowString(unsigned char x, unsigned char y, unsigned char *str) {
    while (*str) {
        if (x + 6 > 128) { x = 0; y++; }
        if (y > 7) return;
        OLED_ShowChar(x, y, *str++);
        x += 6;
    }
}

// ============================================================
// 显示 16 像素高的图像/汉字
//   逐列式取模，高位在下，亮点为 1
//   Image 格式: [col0上, col0下, col1上, col1下, ..., col(W-1)上, col(W-1)下]
//   y: 起始页 (0~6, 因为占 2 页)
//   x: 起始列 (0~127)
//   width: 图像宽度 (像素/列数)
// ============================================================
void OLED_ShowImage_H16(unsigned char y, unsigned char x,
                        unsigned char width, unsigned char *image) {
    unsigned char i;
    if (y <= 7) {
        OLED_SetCursor(y, x);
        for (i = 0; i < width; i++)
            OLED_WriteData(image[i * 2]);
    }
    if (y + 1 <= 7) {
        OLED_SetCursor(y + 1, x);
        for (i = 0; i < width; i++)
            OLED_WriteData(image[i * 2 + 1]);
    }
}
